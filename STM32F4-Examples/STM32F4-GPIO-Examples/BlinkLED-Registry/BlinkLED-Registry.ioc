# file: BlinkLED-Registry.ioc
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Mcu.Family=STM32F4
Mcu.Name=STM32F407V(E-G)Tx
Mcu.Package=LQFP100
NVIC.PriorityGroup=NVIC_PRIORITYGROUP_4
ProjectManager.HeapSize=0x200
ProjectManager.StackSize=0x400
ProjectManager.TargetToolchain=MDK-ARM V5.27
RCC.48MHZClocksFreq_Value=84000000
RCC.AHBFreq_Value=168000000
RCC.APB1CLKDivider=RCC_HCLK_DIV4
RCC.APB1Freq_Value=42000000
RCC.APB1TimFreq_Value=84000000
RCC.APB2CLKDivider=RCC_HCLK_DIV2
RCC.APB2Freq_Value=84000000
RCC.APB2TimFreq_Value=168000000
RCC.CortexFreq_Value=168000000
RCC.FLatency=FLASH_LATENCY_5
RCC.HCLKFreq_Value=168000000
RCC.HSE_VALUE=25000000
RCC.HSI_VALUE=16000000
RCC.LSE_VALUE=32768
RCC.PLLM=8
RCC.PLLN=168
RCC.SYSCLKFreq_VALUE=168000000
RCC.SYSCLKSource=RCC_SYSCLKSOURCE_PLLCLK
RCC.VCOOutputFreq_Value=336000000
board=custom

// file: Core/Src/main.c
/* USER CODE BEGIN Header */
/**
  ******************************************************************************
  * @file           : main.c
  * @brief          : Main program body
  ******************************************************************************
  * @attention
  *
  * <h2><center>&copy; Copyright (c) 2023 STMicroelectronics.
  * All rights reserved.</center></h2>
  *
  * This software component is licensed by ST under BSD 3-Clause license,
  * the "License"; You may not use this file except in compliance with the
  * License. You may obtain a copy of the License at:
  *                        opensource.org/licenses/BSD-3-Clause
  *
  ******************************************************************************
  */
/* USER CODE END Header */
#include "main.h"

/* USER CODE BEGIN PD */
#define LED0_GPIO_Port            GPIOC
#define LED0_Pin                  13

#define LED1_GPIO_Port            GPIOC
#define LED1_Pin                  14

#define LED2_GPIO_Port            GPIOC
#define LED2_Pin                  15
/* USER CODE END PD */

void SystemClock_Config(void);
/* USER CODE BEGIN PFP */
void led_init(GPIO_TypeDef* gpio, uint16_t pin);
void led_toggle(GPIO_TypeDef* gpio, uint16_t pin);
void led_write(GPIO_TypeDef* gpio, uint16_t pin, uint8_t state);
/* USER CODE END PFP */

int main(void)
{

  /* MCU Configuration--------------------------------------------------------*/

  /* Reset of all peripherals, Initializes the Flash interface and the Systick. */
  HAL_Init();

  /* Configure the system clock */
  SystemClock_Config();

  /* Initialize all configured peripherals */
  /* USER CODE BEGIN 2 */
  //__HAL_RCC_GPIOC_CLK_ENABLE();
  RCC->AHB1ENR |= RCC_AHB1ENR_GPIOCEN;

  led_init(LED0_GPIO_Port, LED0_Pin);
  led_init(LED1_GPIO_Port, LED1_Pin);
  led_init(LED2_GPIO_Port, LED2_Pin);
  /* USER CODE END 2 */

  /* Infinite loop */
  /* USER CODE BEGIN WHILE */
  while (1)
  {
    // ---------------- Way 1 -------------------
    /*
    led_toggle(LED0_GPIO_Port, LED0_Pin);
    led_toggle(LED1_GPIO_Port, LED1_Pin);
    led_toggle(LED2_GPIO_Port, LED2_Pin);
    HAL_Delay(500);
    */
    // ---------------- Way 2 -------------------
    led_write(LED0_GPIO_Port, LED0_Pin, 0);
    led_write(LED1_GPIO_Port, LED1_Pin, 0);
    led_write(LED2_GPIO_Port, LED2_Pin, 0);
    HAL_Delay(500);

    led_write(LED0_GPIO_Port, LED0_Pin, 1);
    led_write(LED1_GPIO_Port, LED1_Pin, 1);
    led_write(LED2_GPIO_Port, LED2_Pin, 1);
    HAL_Delay(500);

    /* USER CODE END WHILE */

  }
}

void SystemClock_Config(void)
{
  RCC_OscInitTypeDef RCC_OscInitStruct = {0};
  RCC_ClkInitTypeDef RCC_ClkInitStruct = {0};

  /** Configure the main internal regulator output voltage
  */
  __HAL_RCC_PWR_CLK_ENABLE();
  __HAL_PWR_VOLTAGESCALING_CONFIG(PWR_REGULATOR_VOLTAGE_SCALE1);

  /** Initializes the RCC Oscillators according to the specified parameters
  * in the RCC_OscInitTypeDef structure.
  */
  RCC_OscInitStruct.OscillatorType = RCC_OSCILLATORTYPE_HSI;
  RCC_OscInitStruct.HSIState = RCC_HSI_ON;
  RCC_OscInitStruct.HSICalibrationValue = RCC_HSICALIBRATION_DEFAULT;
  RCC_OscInitStruct.PLL.PLLState = RCC_PLL_ON;
  RCC_OscInitStruct.PLL.PLLSource = RCC_PLLSOURCE_HSI;
  RCC_OscInitStruct.PLL.PLLM = 8;
  RCC_OscInitStruct.PLL.PLLN = 168;
  RCC_OscInitStruct.PLL.PLLP = RCC_PLLP_DIV2;
  RCC_OscInitStruct.PLL.PLLQ = 4;
  if (HAL_RCC_OscConfig(&RCC_OscInitStruct) != HAL_OK)
  {
    Error_Handler();
  }

  /** Initializes the CPU, AHB and APB buses clocks
  */
  RCC_ClkInitStruct.ClockType = RCC_CLOCKTYPE_HCLK|RCC_CLOCKTYPE_SYSCLK
                              |RCC_CLOCKTYPE_PCLK1|RCC_CLOCKTYPE_PCLK2;
  RCC_ClkInitStruct.SYSCLKSource = RCC_SYSCLKSOURCE_PLLCLK;
  RCC_ClkInitStruct.AHBCLKDivider = RCC_SYSCLK_DIV1;
  RCC_ClkInitStruct.APB1CLKDivider = RCC_HCLK_DIV4;
  RCC_ClkInitStruct.APB2CLKDivider = RCC_HCLK_DIV2;

  if (HAL_RCC_ClockConfig(&RCC_ClkInitStruct, FLASH_LATENCY_5) != HAL_OK)
  {
    Error_Handler();
  }
}

/* USER CODE BEGIN 4 */
void led_init(GPIO_TypeDef* gpio, uint16_t pin) {
  // Mode: Deinit set to default, Input
  gpio->MODER &= ~(0x03U << (pin * 2));
  // Mode: Output
  gpio->MODER |= 0x01U << (pin * 2);
  // Output Type: Push-Pull
  gpio->OTYPER &= ~(0x01U << pin);
  // Output Speed: Very High Speed
  gpio->OSPEEDR |= 0x03U << (pin * 2);
}
void led_toggle(GPIO_TypeDef* gpio, uint16_t pin) {
  gpio->ODR ^= 1 << pin;
}
void led_write(GPIO_TypeDef* gpio, uint16_t pin, uint8_t state) {
  // BSRR
  if (state) {
    gpio->BSRR = 1 << pin;
  }
  else {
    gpio->BSRR = 1 << (pin + 16);
  }
  // ODR
  /*if (state) {
    gpio->ODR |= 1 << pin;
  }
  else {
    gpio->ODR &= ~(1 << pin);
  }*/
}
/* USER CODE END 4 */

void Error_Handler(void)
{
  __disable_irq();
  while (1)
  {
  }
}
